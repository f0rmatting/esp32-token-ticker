## sdkconfig.defaults
```kconfig
# 4MB flash (Waveshare ESP32-C6-LCD-1.47)
CONFIG_ESPTOOLPY_FLASHSIZE_4MB=y

# Custom partition table (2MB factory app)
CONFIG_PARTITION_TABLE_CUSTOM=y
CONFIG_PARTITION_TABLE_CUSTOM_FILENAME="partitions.csv"

# ── Compiler Optimization (Performance & Size) ───────────────────
# Performance-oriented optimization (-O2)
CONFIG_COMPILER_OPTIMIZATION_PERF=y
# Link Time Optimization (cross-module optimization)
CONFIG_COMPILER_LTO=y

# ── Power Management (DFS + Light-sleep) ──────────────────────────
CONFIG_PM_ENABLE=y
CONFIG_FREERTOS_TICKLESS_IDLE=y
CONFIG_PM_DFS_INIT_AUTO=y

# ── CPU Frequency ────────────────────────────────────────────────
CONFIG_ESP_DEFAULT_CPU_FREQ_MHZ_160=y

# ── Wi-Fi 6 & HE (ESP32-C6 optimized) ─────────────────────────────
CONFIG_ESP_WIFI_SOFTAP_SAE_SUPPORT=y
CONFIG_ESP_WIFI_ENABLE_SAE_PK=y
CONFIG_ESP_WIFI_GCMP_SUPPORT=y
CONFIG_ESP_WIFI_GMAC_SUPPORT=y
CONFIG_ESP_WIFI_POWER_SAVE_MIN_MODEM=y

# Network-assisted roaming & BSS transition
CONFIG_ESP_WIFI_11KV_SUPPORT=y
CONFIG_ESP_WIFI_RRM_SUPPORT=y
CONFIG_ESP_WIFI_WNM_SUPPORT=y

# Enable DNS Cache for faster API access
CONFIG_LWIP_DNS_CACHE_SIZE=1
# HAP HTTP server needs 8 open sockets + 3 internal = 11 minimum
CONFIG_LWIP_MAX_SOCKETS=16
# SNTP: 2 servers (time.apple.com + pool.ntp.org)
CONFIG_LWIP_SNTP_MAX_SERVERS=2

# ── LVGL setup ──────────────────────────────────────────────────
CONFIG_LV_FONT_MONTSERRAT_10=y
# CONFIG_LV_FONT_MONTSERRAT_12 is not set
CONFIG_LV_FONT_MONTSERRAT_14=y
CONFIG_LV_FONT_MONTSERRAT_18=y
CONFIG_LV_FONT_MONTSERRAT_20=y
CONFIG_LV_FONT_MONTSERRAT_24=y
# CONFIG_LV_FONT_MONTSERRAT_28 is not set
CONFIG_LV_USE_CHART=y

# ── TLS & HTTPS Performance ──────────────────────────────────────
CONFIG_ESP_TLS_USING_MBEDTLS=y
CONFIG_MBEDTLS_CERTIFICATE_BUNDLE=y
CONFIG_MBEDTLS_CERTIFICATE_BUNDLE_DEFAULT_CMN=y
CONFIG_MBEDTLS_HARDWARE_SHA=y
CONFIG_MBEDTLS_HARDWARE_AES=y
CONFIG_MBEDTLS_DYNAMIC_BUFFER=y
CONFIG_MBEDTLS_DYNAMIC_FREE_CA_CERT=y
CONFIG_MBEDTLS_DYNAMIC_FREE_CONFIG_DATA=y

# ── System & Logging (Production Grade) ──────────────────────────
# Silent logs: only ERRORS and WARNINGS shown
CONFIG_LOG_DEFAULT_LEVEL_WARN=y
CONFIG_BOOTLOADER_LOG_LEVEL_WARN=y
CONFIG_ESP_MAIN_TASK_STACK_SIZE=8192

# Slim down memory usage
CONFIG_NEWLIB_NANO_FORMAT=y

# ── Disable unused components ────────────────────────────────────
# CONFIG_MQTT_ENABLED is not set

# ── Network buffer optimization ──────────────────────────────────
CONFIG_LWIP_TCP_SND_BUF_DEFAULT=4096
CONFIG_LWIP_TCP_WND_DEFAULT=4096
CONFIG_LWIP_TCPIP_RECVMBOX_SIZE=16

# ── TLS buffer optimization (API responses < 8KB) ───────────────
CONFIG_MBEDTLS_SSL_IN_CONTENT_LEN=8192
```

## sdkconfig.defaults.esp32s3
```kconfig
# ESP32-S3-LCD-1.47: overrides on top of sdkconfig.defaults

# 16MB flash
CONFIG_ESPTOOLPY_FLASHSIZE_16MB=y

# CPU frequency
CONFIG_ESP_DEFAULT_CPU_FREQ_MHZ_240=y

# PSRAM (Octal SPI, 80MHz)
CONFIG_SPIRAM=y
CONFIG_SPIRAM_MODE_OCT=y
CONFIG_SPIRAM_SPEED_80M=y
```
